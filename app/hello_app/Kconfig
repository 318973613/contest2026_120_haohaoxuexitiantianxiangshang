## app/hello_app/Kconfig
```kconfig
#
# Contest 2026 team 120 study terminal
#

menuconfig LVX_USE_DEMO_CONTEST2026_120_STUDY_TERMINAL
	tristate "Contest 2026 team 120 study terminal"
	default n
	depends on GRAPHICS_LVGL
	---help---
		Enable the LVGL AI study and debugging terminal demo.

if LVX_USE_DEMO_CONTEST2026_120_STUDY_TERMINAL

config LVX_USE_DEMO_CONTEST2026_120_STUDY_TERMINAL_PRIORITY
	int "Study terminal task priority"
	default 100

config LVX_USE_DEMO_CONTEST2026_120_STUDY_TERMINAL_STACKSIZE
	int "Study terminal stack size"
	default 49152

endif
```

## app/minui/Kconfig
```kconfig
config LVX_USE_DEMO_MINUI
	tristate "Minimal LVGL UI crash probe"
	default n
	depends on GRAPHICS_LVGL
	---help---
		Minimal LVGL UI used to bisect the flush_cb crash.
```
